## Documentation/devicetree/bindings/soc/intel/intel,dfl-mmio.yaml
```yaml
# SPDX-License-Identifier: (GPL-2.0-only OR BSD-2-Clause)
%YAML 1.2
---
$id: "http://devicetree.org/schemas/soc/intel/intel,dfl-mmio.yaml#"
$schema: "http://devicetree.org/meta-schemas/core.yaml#"
title: Device Feature List (DFL) for MMIO

maintainers:
  - Basheer Ahmed Muddebihal <basheer.ahmed.muddebihal@linux.intel.com>

description: |
  Device Feature List defines a linked list of feature headers within the device
  MMIO space to provide an extensible way of adding features. Please see the link
  for more information https://docs.kernel.org/fpga/dfl.html.

properties:
  compatible:
    const: intel,dfl-mmio

  reg:
    maxItems: 1
    description:
      The 'reg' property within the node serves to define the memory-mapped
      address range for the DFL. The first value in the 'reg' property specifies
      the starting address of the DFL, and the second value represents the
      length of the address range from start address of the DFL.

  interrupt-parent:
    maxItems: 1
    description:
      This property establishes a reference to the Interrupt Controller Node,
      which manages interrupts for the device.

  interrupt-user-start:
    maxItems: 1
    description:
      This property defines the initial user interrupts available on the specified
      controller. GIC are reserved for local purposes

  fpga-interrupt-start:
    maxItems: 1
    descritpion:
      This property indicates the starting interrupt number within the GIC where
      FPGA-specific interrupts are mapped.

  fpga-interrupt-lines:
    maxItems: 1
    descritpions:
      This property specifies the total count of Interrupt Requests (IRQs)
      originating from the FPGA and routed to the GIC.

required:
  - compatible
  - reg

additionalProperties: false

examples:
  - |
    dfl0: dfl@F9000000 {
        compatible = "intel,dfl-mmio";
        reg = <0xF9000000  0x00002000>;
        interrupt-parent = <&intc>;
        interrupt-user-start = <32>;
        fpga-interrupt-start = <49>;
        fpga-interrupt-lines = <64>;
    };
```

## configs/n3000_d5005_defconfig
```kconfig
CONFIG_FPGA_DFL=m
CONFIG_FPGA_DFL_FME=m
CONFIG_FPGA_DFL_FME_MGR=m
CONFIG_FPGA_DFL_FME_BRIDGE=m
CONFIG_FPGA_DFL_FME_REGION=m
CONFIG_FPGA_DFL_AFU=m
CONFIG_FPGA_DFL_NIOS_INTEL_PAC_N3000=m
CONFIG_FPGA_DFL_SPI_ALTERA=m
CONFIG_FPGA_DFL_PCI=m
CONFIG_FPGA_DFl_HSSI=m
CONFIG_FPGA_DFL_INTEL_S10_IOPLL=m

CONFIG_FPGA=m
CONFIG_FPGA_BRIDGE=m
CONFIG_FPGA_REGION=m

CONFIG_FPGA_SEC_MGR=m
CONFIG_IFPGA_M10_BMC_SECURE=m

CONFIG_UIO_DFL=m

CONFIG_SENSORS_INTEL_M10_BMC_HWMON=m
CONFIG_MFD_INTEL_M10_BMC_SPI=m
CONFIG_MFD_INTEL_M10_BMC_PMCI=m
CONFIG_MFD_INTEL_M10_BMC_LOG=m

CONFIG_SPI_ALTERA=m

CONFIG_INTEL_S10_PHY=m
CONFIG_INTEL_M10_BMC_RETIMER=m
CONFIG_S10HSSI=m

CONFIG_REGMAP_MMIO=m

CONFIG_MEMORY=y
CONFIG_FPGA_DFL_EMIF=m

CONFIG_IIO_INTERRUPT_TRIGGER=m
```

## configs/n5010_defconfig
```kconfig
CONFIG_FPGA_DFL=m
CONFIG_FPGA_DFL_FME=m
CONFIG_FPGA_DFL_FME_MGR=m
CONFIG_FPGA_DFL_FME_BRIDGE=m
CONFIG_FPGA_DFL_FME_REGION=m
CONFIG_FPGA_DFL_AFU=m
CONFIG_FPGA_DFL_SPI_ALTERA=m
CONFIG_FPGA_DFL_PCI=m

CONFIG_FPGA_VFIO_MDEV_DFL=m

CONFIG_FPGA=m
CONFIG_FPGA_MGR=m
CONFIG_FPGA_BRIDGE=m
CONFIG_FPGA_REGION=m
CONFIG_FPGA_SEC_MGR=m
CONFIG_IFPGA_M10_BMC_SECURE=m

CONFIG_SPI=y
CONFIG_SPI_MASTER=y
CONFIG_MFD_INTEL_M10_BMC=m
CONFIG_SENSORS_INTEL_M10_BMC_HWMON=m

CONFIG_SPI_ALTERA=m

CONFIG_FIXED_PHY=m
CONFIG_NET_VENDOR_SILICOM=y
CONFIG_N5010_HSSI=m
CONFIG_n5010_PHY=m

CONFIG_REGMAP_MMIO=m
CONFIG_REGMAP_INDIRECT_REGISTER=m
CONFIG_REGMAP_SPI_AVMM=m
```

## drivers/net/ethernet/silicom/Kconfig
```kconfig
# SPDX-License-Identifier: GPL-2.0-only
#
# Silicom network device configuration
#

config NET_VENDOR_SILICOM
	bool "Silicom devices"
	default y
	help
	  If you have a network (Ethernet) card belonging to this class, say Y.

	  Note that the answer to this question doesn't directly affect the
	  kernel: saying N will just cause the configurator to skip all
	  the questions about Silicom cards. If you say Y, you will be asked for
	  your specific card in the following questions.

if NET_VENDOR_SILICOM

config N5010_PHY
	tristate "Fixed Phy Driver for Silicom PAC N5010"
	depends on MFD_INTEL_M10_BMC && FIXED_PHY
	help
	  The n5010 card consists of a primary FPGA running the network controller,
	  and a side-fpga running the board management controller (bmc). This driver
	  reads status bits and controls link LEDs via the bmc.

endif # NET_VENDOR_SILICOM
```
